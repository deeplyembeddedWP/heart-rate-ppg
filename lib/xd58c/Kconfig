## lib/xd58c/Kconfig
```kconfig
config XD58C
    bool "XD-58C pulse sensor driver"
    depends on ADC
    select ADC_ASYNC
    help
      Enable driver for the XD-58C optical pulse sensor.
      Provides continuous async ADC sampling, LPF, peak
      detection, BPM calculation and real-time data output.

if XD58C

config XD58C_LOG_LEVEL
    int "XD-58C log level"
    default 3
    range 0 4
    help
      0=OFF 1=ERR 2=WRN 3=INF 4=DBG

config XD58C_FFT_BPM
    bool "FFT-based BPM calculation"
    depends on XD58C
    select CMSIS_DSP
    select CMSIS_DSP_TRANSFORM
    select CMSIS_DSP_WINDOW
    help
      Accumulates 512 samples at 200 Hz, applies a Hann window, performs
      a 512-point real FFT, and emits "BPM:xx\r\n" every 256 samples
      (~1.28 s) instead of the raw sample stream.

endif # XD58C
```
